## base_external/package/Config.in
```kconfig
source "aesd-assignments/Config.in"
source "aesd-socketApp/Config.in"
source "ldd/Config.in"
```

## base_external/package/aesdchar/Config.in
```kconfig
config BR2_PACKAGE_AESDCHAR
    bool "aesdchar"
    depends on BR2_LINUX_KERNEL
    help
        circular buffer 
```

## base_external/package/ldd/Config.in
```kconfig
config BR2_PACKAGE_LDD
    bool "ldd"
    depends on BR2_LINUX_KERNEL
    help
        LDD3 kernel modules (scull, misc-modules, faulty, hello)
```
